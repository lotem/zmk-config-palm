## boards/shields/palm/Kconfig.defconfig
```kconfig
if SHIELD_PALM_LEFT

config ZMK_KEYBOARD_NAME
    default "TIS Palm"

config ZMK_SPLIT_ROLE_CENTRAL
    default y

endif

if SHIELD_PALM_LEFT || SHIELD_PALM_RIGHT

config ZMK_SPLIT
    default y

endif
```

## boards/shields/palm/Kconfig.shield
```kconfig
config SHIELD_PALM_LEFT
    def_bool $(shields_list_contains,palm_left)

config SHIELD_PALM_RIGHT
    def_bool $(shields_list_contains,palm_right)
```
